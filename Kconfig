## Kconfig
```kconfig
menu "Frequency Library"

    config FREQUENCY_STD_FORMAT
        bool "Enable std::format support"
        default y
        help
            Include <format> and provide std::formatter specializations
            for frequency types. Disable if <format> is unavailable or
            undesired.

endmenu
```
